## Kconfig.w5100
```kconfig
# W5100 Ethernet driver configuration options

# Copyright (c) 2020 Linumiz
# Author: Parthiban Nallathambi <parthiban@linumiz.com>
# SPDX-License-Identifier: Apache-2.0

menuconfig ETH_W5100
	bool "W5100 Ethernet Controller"
	depends on SPI
	help
	  W5100 Stand-Alone Ethernet Controller
	  with SPI Interface

config ETH_W5100_RX_THREAD_STACK_SIZE
	int "Stack size for internal incoming packet handler"
	depends on ETH_W5100
	default 800
	help
	  Size of the stack used for internal thread which is ran for
	  incoming packet processing.

config ETH_W5100_RX_THREAD_PRIO
	int "Priority for internal incoming packet handler"
	depends on ETH_W5100
	default 2
	help
	  Priority level for internal thread which is ran for incoming
	  packet processing.

config ETH_W5100_TIMEOUT
	int "IP buffer timeout"
	depends on ETH_W5100
	default 100
	help
	  Given timeout in milliseconds. Maximum amount of time
	  that the driver will wait from the IP stack to get
	  a memory buffer before the Ethernet frame is dropped.
```
